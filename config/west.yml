## dts/bindings/behaviors/zmk,behavior-ruen-toggle.yaml
```yaml
description: RuEn lang toggle behavior

compatible: "zmk,behavior-ruen-toggle"

include: zero_param.yaml

properties:
  bindings:
    type: phandles
    required: true
```
